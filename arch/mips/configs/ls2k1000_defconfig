## arch/mips/loongson/Kconfig
```kconfig
if MACH_LOONGSON

choice
	prompt "Machine Type"

config LEMOTE_FULOONG2E
	bool "Lemote Fuloong(2e) mini-PC"
	select ARCH_SPARSEMEM_ENABLE
	select CEVT_R4K
	select CSRC_R4K
	select SYS_HAS_CPU_LOONGSON2E
	select DMA_NONCOHERENT
	select BOOT_ELF32
	select BOARD_SCACHE
	select HW_HAS_PCI
	select I8259
	select ISA
	select IRQ_CPU
	select SYS_SUPPORTS_32BIT_KERNEL
	select SYS_SUPPORTS_64BIT_KERNEL
	select SYS_SUPPORTS_LITTLE_ENDIAN
	select SYS_SUPPORTS_HIGHMEM
	select SYS_HAS_EARLY_PRINTK
	select GENERIC_ISA_DMA_SUPPORT_BROKEN
	select CPU_HAS_WB
	select LOONGSON_MC146818
	help
	  Lemote Fuloong(2e) mini-PC board based on the Chinese Loongson-2E CPU and
	  an FPGA northbridge

	  Lemote Fuloong(2e) mini PC have a VIA686B south bridge.

config LEMOTE_MACH2F
	bool "Lemote Loongson 2F family machines"
	select ARCH_SPARSEMEM_ENABLE
	select BOARD_SCACHE
	select BOOT_ELF32
	select CEVT_R4K if ! MIPS_EXTERNAL_TIMER
	select CPU_HAS_WB
	select CS5536
	select CSRC_R4K if ! MIPS_EXTERNAL_TIMER
	select DMA_NONCOHERENT
	select GENERIC_ISA_DMA_SUPPORT_BROKEN
	select HAVE_CLK
	select HW_HAS_PCI
	select I8259
	select IRQ_CPU
	select ISA
	select SYS_HAS_CPU_LOONGSON2F
	select SYS_HAS_EARLY_PRINTK
	select SYS_SUPPORTS_32BIT_KERNEL
	select SYS_SUPPORTS_64BIT_KERNEL
	select SYS_SUPPORTS_HIGHMEM
	select SYS_SUPPORTS_LITTLE_ENDIAN
	select LOONGSON_MC146818
	help
	  Lemote Loongson 2F family machines utilize the 2F revision of
	  Loongson processor and the AMD CS5536 south bridge.

	  These family machines include fuloong2f mini PC, yeeloong2f notebook,
	  LingLoong allinone PC and so forth.

config LOONGSON_MACH3X
	bool "Generic Loongson 3 family machines"
	select ARCH_SPARSEMEM_ENABLE
	select GENERIC_ISA_DMA_SUPPORT_BROKEN
	select GENERIC_HARDIRQS_NO__DO_IRQ
	select BOOT_ELF32
	select BOARD_SCACHE
	select CSRC_R4K
	select CEVT_R4K
	select CPU_HAS_WB
	select HAVE_CLK
	select HW_HAS_PCI
	select ISA
	select I8259
	select IRQ_CPU
	select SYS_HAS_CPU_LOONGSON3
	select SYS_HAS_EARLY_PRINTK
	select SYS_SUPPORTS_SMP
	select SYS_SUPPORTS_NUMA
	select SYS_SUPPORTS_32BIT_KERNEL
	select SYS_SUPPORTS_64BIT_KERNEL
	select SYS_SUPPORTS_HIGHMEM
	select SYS_SUPPORTS_LITTLE_ENDIAN
	select LOONGSON_MC146818
	select ZONE_DMA32 if 64BIT
	select DMA_MAYBE_COHERENT
	select UEFI_FIRMWARE_INTERFACE
	select PHYS48_TO_HT40
	select USE_OF
	select BUILTIN_DTB
	help
		Generic Loongson 3 family machines utilize the 3A/3B revision
		of Loongson processor and RS780/SBX00 chipset.
endchoice

config PCI_MSI_IRQ_BALANCE
	bool "ht irq stipe4 for pci msi irq balance"
	depends on LOONGSON_MACH3X && PCI_MSI

config CS5536
	bool

config CS5536_MFGPT
	bool "CS5536 MFGPT Timer"
	depends on CS5536
	select MIPS_EXTERNAL_TIMER
	help
	  This option enables the mfgpt0 timer of AMD CS5536.

	  If you want to enable the Loongson2 CPUFreq Driver, Please enable
	  this option at first, otherwise, You will get wrong system time.

	  If unsure, say Yes.

config GS464E_NODE_COUNTER
	bool "Loongson3 Node Counter"
	depends on LOONGSON_MACH3X
	select MIPS_EXTERNAL_TIMER
	help
	  This option enables the node counter of Loongson3A(B)2000/3000.

	  If you want to ease the contension of AMD RS780/SBX0 HPET device space reading,
	  Please enable this option. This option replace HPET CSRC with node counter.

	  If unsure, say No.

config GS464V_STABLE_COUNTER
	bool "Loongson3 Stable Counter"
	depends on LOONGSON_MACH3X
	help
	  This option enables the stable counter of Loongson3A3000_COMP.

	  If you want to enable loongson4k StableCounter Driver,Please enable this option.
	  This option replace node counter with stable counter.

	  If unsure, say No.

config LOONGSON_SUPPORT_IP5
	bool "Loongson3 ip5 support"
	depends on LOONGSON_MACH3X
	default n
	help
	  This option enables irqs routing to IP5.

	  If you want to use irqs routing to IP5 of loongson3,
	  Please enable this option.

	  If unsure, say No.

menuconfig LOONGSON3_HPET_SUPPORT
	bool "Loongson3 HPET Support"
	depends on LOONGSON_MACH3X

if LOONGSON3_HPET_SUPPORT
config RS780_HPET
	bool "RS780/SBX00 HPET Timer"
	depends on LOONGSON_MACH3X
	select MIPS_EXTERNAL_TIMER
	help
	  This option enables the hpet timer of AMD RS780/SBX00.

	  If you want to enable the Loongson3 CPUFreq Driver, Please enable
	  this option at first, otherwise, You will get wrong system time.

	  If unsure, say Yes.

config LS7A_HPET
	bool "LS7A HPET Timer"
	depends on LOONGSON_MACH3X
	select MIPS_EXTERNAL_TIMER
	help
	  This option enables the hpet timer of LS7A.

	  If you want to enable the Loongson3 CPUFreq Driver, Please enable
	  this option at first, otherwise, You will get wrong system time.

	  If unsure, say Yes.

endif # LOONGSON3_HPET_SUPPORT

config CPU_SUPPORTS_UNCACHED_ACCELERATED
	bool "CPU support uncached accelerated"
	default n
	depends on CPU_LOONGSON3
	help
	  IF set Y ,framebuffer driver will access memory by uncached accelerated which
	  reflected in ioremap and mmap.

config LS7A_MSI_SUPPORT
	bool "LS7A MSI Support"
	depends on LOONGSON_MACH3X
	help
	  This option enables the MSI of LS7A.

	  If unsure, say Yes.

config LOONGSON_UART_BASE
	bool
	default y
	depends on EARLY_PRINTK || SERIAL_8250

config IOMMU_HELPER
	bool

config NEED_SG_DMA_LENGTH
	bool

config SWIOTLB
	bool "Soft IOMMU Support for Big Memory (>4GB)"
	depends on CPU_LOONGSON3
	select IOMMU_HELPER
	select NEED_SG_DMA_LENGTH
	select NEED_DMA_MAP_STATE

config PHYS48_TO_HT40
	bool
	default y if CPU_LOONGSON3

config PHASE_LOCK
	bool "Loongson3 Hierarchical Lock Support"
	default y
	depends on CPU_LOONGSON3
	help
	  Say Y to compile the kernel to support hierarchical lock (PHASE_LOCK).
	  This option improves performance on systems with more than two nodes.

config LOONGSON_MC146818
	bool
	default n

config UEFI_FIRMWARE_INTERFACE
	bool

config HAVE_SETUP_PER_CPU_AREA
	def_bool y

config NEED_PER_CPU_EMBED_FIRST_CHUNK
	def_bool y

config ARCH_HAS_CPU_AUTOPROBE
	def_bool y
endif # MACH_LOONGSON
```

## arch/mips/loongson2/Kconfig
```kconfig
if MACH_LOONGSON2
choice
	prompt "Machine Type"

config 2K1000_SBC
	bool "Loongson 2K1000 Single Board Computer"
	select GENERIC_ISA_DMA_SUPPORT_BROKEN
	select BOOT_ELF32
	select CSRC_R4K
	select CEVT_R4K
	select SYNC_R4K
	select IRQ_CPU
	select HW_HAS_PCI
	select SYS_HAS_CPU_LOONGSON2K
	select SYS_SUPPORTS_LITTLE_ENDIAN
	select SYS_SUPPORTS_64BIT_KERNEL
	select SYS_SUPPORTS_SMP
	select SYS_HAS_EARLY_PRINTK
	help
		Loongson 2K1000 SBC
endchoice

endif
```

## arch/mips/loongson2/ls2k/Kconfig
```kconfig
if MACH_LOONGSON2K

choice
	prompt "Machine Type"

config LOONGSON_MACH2K
	bool "Generic Loongson 2k family machines"
	select ARCH_SPARSEMEM_ENABLE
	select GENERIC_ISA_DMA_SUPPORT_BROKEN
	select BOOT_ELF32
	select BOARD_SCACHE
	select CSRC_R4K
	select CEVT_R4K
	select CPU_HAS_WB
	select HW_HAS_PCI
	select IRQ_CPU
	select SYS_HAS_CPU_LOONGSON2K
	select SYS_HAS_EARLY_PRINTK
	select SYS_SUPPORTS_SMP
	select SYS_SUPPORTS_64BIT_KERNEL
	select SYS_SUPPORTS_HIGHMEM
	select SYS_SUPPORTS_LITTLE_ENDIAN
	select ZONE_DMA32
	select UEFI_FIRMWARE_INTERFACE
	select SYS_SUPPORTS_HOTPLUG_CPU
	select SYNC_R4K
	#select ARCH_REQUIRE_GPIOLIB
	select NEED_SG_DMA_LENGTH
	help
		Generic Loongson 2K family machines utilize the 3A/3B revision of
		Loongson processor and RS780/SBX00/2H chipset.
endchoice

config SWIOTLB
	bool "Soft IOMMU Support for Big Memory (>4GB)"
	depends on CPU_LOONGSON2K
	select IOMMU_HELPER
	select NEED_SG_DMA_LENGTH
	select NEED_DMA_MAP_STATE

config NEED_SG_DMA_LENGTH
	bool

config ARCH_SPARSEMEM_ENABLE
	bool
	select SPARSEMEM_STATIC

config UEFI_FIRMWARE_INTERFACE
	bool

endif # MACH_LOONGSON2K
```

## drivers/crypto/sedriver/Kconfig
```kconfig
#
# se chip configuration
#
config SW_SE_CHIP
	tristate "se chip driver"
	default  m
	---help---
		If unsure, say N.
```

## drivers/gpu/drm/loongson/Kconfig
```kconfig
config DRM_LOONGSON_VGA
	tristate "LOONGSON VGA DRM"
	depends on DRM && PCI
	select FB_SYS_FILLRECT
	select FB_SYS_COPYAREA
	select FB_SYS_IMAGEBLIT
	select DRM_KMS_HELPER
	select DRM_KMS_FB_HELPER
	select DRM_TTM
	default n
	help
	  DRM display driver for loongson vga control.
```

## drivers/platform/mips/Kconfig
```kconfig
#
# MIPS Platform Specific Drivers
#

menuconfig MIPS_PLATFORM_DEVICES
	bool "MIPS Platform Specific Device Drivers"
	default y
	help
	  Say Y here to get to see options for device drivers of various
	  MIPS platforms, including vendor-specific netbook/laptop/pc extension
	  drivers.  This option alone does not add any kernel code.

	  If you say N, all options in this submenu will be skipped and disabled.

if MIPS_PLATFORM_DEVICES

config LEMOTE3A_LAPTOP
	tristate "Lemote Loongson-3A Laptop Driver"
	depends on LOONGSON_MACH3X
	select BACKLIGHT_LCD_SUPPORT
	select LCD_CLASS_DEVICE
	select BACKLIGHT_CLASS_DEVICE
	select POWER_SUPPLY
	select HWMON
	select VIDEO_OUTPUT_CONTROL
	select INPUT_SPARSEKMAP
	select INPUT_EVDEV
	select LEDS_CLASS
	depends on INPUT
	default y
	help
	  Lemote Loongson-3A/2Gq family laptops driver.

config LOONGSON_LAPTOP
	tristate "Loongson Laptop pm and hotkey driver"
	depends on CPU_LOONGSON3
	select BACKLIGHT_CLASS_DEVICE
	select LCD_CLASS_DEVICE
	select BACKLIGHT_LCD_SUPPORT
	select VIDEO_OUTPUT_CONTROL
	depends on INPUT
	select INPUT_SPARSEKMAP
	select INPUT_EVDEV
	default y
	---help---
	  This is a driver for Loongson laptops, include power and hotkey
	  driver;

config LOONGSON_EA_PM_HOTKEY
	tristate "PM and Hotkey driver for EA Laptio and Minipc"
	depends on CPU_LOONGSON3
	select BACKLIGHT_CLASS_DEVICE
	select LCD_CLASS_DEVICE
	select BACKLIGHT_LCD_SUPPORT
	select VIDEO_OUTPUT_CONTROL
	depends on INPUT
	select INPUT_SPARSEKMAP
	select INPUT_EVDEV
	default y
	---help---
	  This is a driver for EASCS Loongson laptops, include power and hotkey
	  driver;

config LOONGSON_BITLAND_PM_HOTKEY
	tristate "PM and Hotkey driver for Bitland Laptop"
	depends on CPU_LOONGSON3
	select BACKLIGHT_CLASS_DEVICE
	select LCD_CLASS_DEVICE
	select BACKLIGHT_LCD_SUPPORT
	select VIDEO_OUTPUT_CONTROL
	depends on INPUT
	select INPUT_SPARSEKMAP
	select INPUT_EVDEV
	default y
	---help---
	  This is a driver for Bitland Loongson laptops, include power and hotkey
	  driver;
endif # MIPS_PLATFORM_DEVICES
```

## sound/soc/loongson/Kconfig
```kconfig
config SND_LS
	tristate "SoC Audio for the LOONGSON chip"
	depends on MACH_LOONGSON2
	select SND_SOC_UDA1342
	help
	  Say Y or M if you want to add support for codecs attached to
	  the PXA2xx AC97, I2S or SSP interface. You will also need
	  to select the audio interfaces to support below.
```
